/ {
    buttons {
        compatible = "gpio-keys";
        hts221_drdy0: hts221_drdy0 {
            gpios = <&gpio0 0x18 GPIO_ACTIVE_HIGH>;
            // gpios = hts221,drdy-gpios;
            label = "HTS221 Data Ready Pin";
        };
    };
};